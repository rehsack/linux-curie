/*
 * Copyright (C) 2013 Freescale Semiconductor, Inc.
 *
 * This program is free software; you can redistribute it and/or modify
 * it under the terms of the GNU General Public License version 2 as
 * published by the Free Software Foundation.
 */

/dts-v1/;

#include "imx6dl.dtsi"
#include "imx6qdl-curie.dtsi"

/ {
	model = "WindSolve i.MX6 DualLite Curie Board";
	compatible = "ws,imx6dl-curie", "fsl,imx6dl";
};

&pxp {
	status = "okay";
};
