## drivers/mxc/hdmi-cec/Kconfig
```kconfig
menu "MXC HDMI CEC (Consumer Electronics Control) support"

config MXC_HDMI_CEC
	tristate "Support for MXC HDMI CEC (Consumer Electronics Control) V2.2"
	depends on MFD_MXC_HDMI
	depends on FB_MXC_HDMI || DRM_IMX_HDMI
	help
	  The HDMI CEC device implement low level protocol on i.MX6x platforms.

config MXC_HDMI_CEC_V30
	tristate "Support for MXC HDMI CEC (Consumer Electronics Control) V3.0"
	depends on MFD_MXC_HDMI
	depends on (FB_MXC_HDMI || DRM_IMX_HDMI) && MXC_HDMI_CEC=n
	help
	  The HDMI CEC device implement low level protocol on i.MX6x platforms.

endmenu
```
